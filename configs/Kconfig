## configs/Kconfig
```kconfig
mainmenu "Mado System Configuration"

config CONFIGURED
    bool
    default y

menu "Toolchain Configuration"

# Compiler detection using scripts/detect-compiler.py
config COMPILER_TYPE
    string
    default "$(shell,python3 scripts/detect-compiler.py 2>/dev/null || echo Unknown)"

config CC_IS_EMCC
    def_bool $(python,assert run(sys.executable, 'scripts/detect-compiler.py', '--is', 'Emscripten'))

config CC_IS_CLANG
    def_bool $(python,assert run(sys.executable, 'scripts/detect-compiler.py', '--is', 'Clang'))

config CC_IS_GCC
    def_bool $(python,assert run(sys.executable, 'scripts/detect-compiler.py', '--is', 'GCC'))

# Cross-compilation support detection
config CROSS_COMPILE_ENABLED
    def_bool $(python,assert os.environ.get('CROSS_COMPILE'))

config CROSS_COMPILE_PREFIX
    string
    default "$(CROSS_COMPILE)"

comment "Toolchain Information"

comment "Build mode: WebAssembly (Emscripten)"
    depends on CC_IS_EMCC

comment "Build mode: Cross-compilation"
    depends on CROSS_COMPILE_ENABLED && !CC_IS_EMCC

comment "Build mode: Native"
    depends on !CROSS_COMPILE_ENABLED && !CC_IS_EMCC

endmenu

# Dependency detection using Kconfiglib $(python,...) preprocessor function
# For Emscripten builds, libraries are provided via ports system (-sUSE_*)
# and do not require host pkg-config detection

config HAVE_SDL2
    bool
    default n if CC_IS_EMCC
    default $(python,assert run('pkg-config', '--exists', 'sdl2')) if !CC_IS_EMCC

config HAVE_PIXMAN
    default n if CC_IS_EMCC
    def_bool $(python,assert run('pkg-config', '--exists', 'pixman-1')) if !CC_IS_EMCC

config HAVE_LIBPNG
    bool
    default y if CC_IS_EMCC
    default $(python,assert run('pkg-config', '--exists', 'libpng')) if !CC_IS_EMCC

config HAVE_LIBJPEG
    bool
    default y if CC_IS_EMCC
    default $(python,assert run('pkg-config', '--exists', 'libjpeg')) if !CC_IS_EMCC

config HAVE_CAIRO
    default n if CC_IS_EMCC
    def_bool $(python,assert run('pkg-config', '--exists', 'cairo')) if !CC_IS_EMCC

choice
    prompt "Backend Selection"
    default BACKEND_WASM if CC_IS_EMCC
    default BACKEND_SDL
    help
      Select the display backend for window system rendering.
      Only one backend can be active at a time.

config BACKEND_DRM
    bool "Linux DRM support"
    depends on !CC_IS_EMCC
    select CURSOR
    help
      Direct Linux DRM (Direct Rendering Manager) backend for embedded
      systems. Renders directly to DRM/KMS without X11/Wayland.
      Requires Linux input subsystem for keyboard/mouse events.

config BACKEND_SDL
    bool "SDL video output support"
    depends on HAVE_SDL2 && !CC_IS_EMCC
    help
      Cross-platform SDL2 backend for native development and testing.

config BACKEND_FBDEV
    bool "Linux framebuffer support"
    depends on !CC_IS_EMCC
    imply CURSOR
    help
      Direct Linux framebuffer backend for embedded systems.
      Renders directly to /dev/fb0 without X11/Wayland.
      Requires Linux input subsystem for keyboard/mouse events.

config BACKEND_VNC
    bool "VNC server output support"
    depends on !CC_IS_EMCC
    help
      Remote access backend using neatvnc library.
      Allows headless operation with VNC client connections.

config BACKEND_HEADLESS
    bool "Headless backend"
    depends on !CC_IS_EMCC
    help
      Shared memory backend for testing and automation.
      Renders to memory without display hardware or VNC.
      Designed for CI/CD pipelines and automated testing.

config BACKEND_WASM
    bool "Native WebAssembly backend"
    depends on CC_IS_EMCC
    help
      Lightweight WebAssembly backend without SDL dependency.

      This backend uses direct Canvas 2D API rendering and
      browser-native image decoding (JPEG/PNG).

endchoice

comment "WebAssembly builds use the native WASM backend (no SDL dependency)"
    depends on CC_IS_EMCC

choice
    prompt "Renderer Selection"
    default RENDERER_BUILTIN
    help
      Select the rendering engine for graphics operations.
      Only one renderer can be active at a time.

config RENDERER_BUILTIN
    bool "Built-in pixel manipulation"
    help
      Native C implementation of rendering primitives.
      Zero external dependencies for graphics operations.
      Suitable for embedded systems and minimal deployments.

config RENDERER_PIXMAN
    bool "Pixman based rendering"
    depends on HAVE_PIXMAN
    help
      Use Pixman library for optimized rendering operations.
      Provides SIMD-accelerated compositing and blending.
      Better performance for complex graphics workloads.

endchoice

menu "Features"

config LOGGING
    bool "Enable logging"
    default y
    help
      Enable debug and informational logging system.
      Provides runtime visibility into system operations.

config LOGGING_COLOR
    bool "Use colors for logging"
    default y
    depends on LOGGING
    help
      Colorize log output for better readability.
      Uses ANSI color codes in terminal output.
      Helps distinguish log levels visually.
      Disable if output is redirected to files.

config LOGGING_CALLBACK
    bool "Enable callback functions"
    default y
    depends on LOGGING
    help
      Allow custom callback functions for log handling.
      Enables application-specific log processing.

config MEMORY_STATS
    bool "Enable memory usage tracking"
    default y
    help
      Track heap allocation statistics including current usage,
      peak usage, and allocation counts. Adds small overhead per
      malloc/free call. Useful for profiling memory consumption
      on constrained devices.

config MEM_TLSF
    bool "Use TLSF allocator for heap"
    default n
    help
      Replace system malloc with the TLSF (Two-Level Segregated Fit)
      allocator backed by a fixed-size memory pool. Provides O(1)
      allocation and deallocation with bounded fragmentation, suitable
      for real-time embedded targets without a system heap.

      When disabled, the system malloc/free is used directly.

config MEM_TLSF_POOL_SIZE
    int "TLSF pool size in bytes"
    default 65536
    range 4096 8388608
    depends on MEM_TLSF
    help
      Size of the static memory pool backing the TLSF allocator.
      Must be large enough for all runtime allocations including
      pixmap buffers. A 640x480 ARGB32 screen pixmap alone needs
      ~1.2 MB; the SDL demo with multiple windows peaks at ~8 MB.
      Embedded targets with small displays need far less (e.g.
      320x240 RGB565 = ~150 KB framebuffer + widget overhead).
      Requests exceeding pool capacity return NULL.

comment "Logging is disabled"
    depends on !LOGGING

config CURSOR
    bool "Manipulate cursor"
    default n
    depends on !BACKEND_VNC
    help
      Enable custom cursor rendering and manipulation.
      Allows application control over cursor appearance.

menu "Window Management"

choice
    prompt "Window manager"
    default WM_DESKTOP
    help
      Select the window manager policy built into the library.  Only one
      can be built at a time; the 'none' policy (no decorations, no
      placement) is always available besides it, and
      twin_screen_set_wm() switches between the two at run time.

config WM_DESKTOP
    bool "Desktop window manager"
    help
      Overlapping windows with title bars, click-to-raise, drag-to-move,
      double-click maximize, edge snapping, corner resizing,
      iconify/restore, close, and a drop shadow under the active window.
      Selected at run time with twin_screen_set_wm(screen, TwinWmDesktop).

      Costs ~3-4 KB .text on ARM Cortex-M class targets.

config WM_MOBILE
    bool "Mobile window manager"
    help
      Phone-style shell: application windows stack over the work area
      between optional system bars (status bar, navigation bar), only the
      top application is visible, and push/pop/dismiss transitions plus
      an edge-swipe back gesture animate retained pixels without
      repainting applications.  Escape also goes back.
      Selected at run time with twin_screen_set_wm(screen, TwinWmMobile).

config WM_NONE
    bool "None"
    help
      Build only the 'none' policy: no decorations, every application
      window covers the screen, and the keyboard goes to the newest or the
      last pressed window.

endchoice

config WM_MOBILE_EVICT
    bool "Release pixels of covered applications"
    default y
    depends on WM_MOBILE
    help
      Free the pixmap of every application hidden under the top one and
      repaint it from application state when it is revealed again.
      Keeps memory at one work-area surface regardless of stack depth.

config DROP_SHADOW
    bool "Window drop shadows"
    default y
    depends on !WM_NONE
    help
      Cast a soft shadow under the active desktop window and under the
      sliding window of mobile transitions.  The compositor synthesizes
      it while scanning out, so it needs no extra pixmap memory and no
      blur pass, but every shadowed span costs blending on scan-out;
      small targets can turn it off and keep plain slides.

config HORIZONTAL_OFFSET
    int "Horizontal offset"
    default 6
    range 1 10
    depends on DROP_SHADOW
    help
      Horizontal shadow offset in pixels.
      Default matches a CSS-style soft shadow (≈6 px offset).
      Larger values push shadow further right.

config VERTICAL_OFFSET
    int "Vertical offset"
    default 6
    range 1 10
    depends on DROP_SHADOW
    help
      Vertical shadow offset in pixels.
      Default matches a CSS-style soft shadow (≈6 px offset).
      Larger values push shadow further down.

config SHADOW_BLUR
    int "Shadow blur radius"
    default 12
    range 1 15
    depends on DROP_SHADOW
    help
      Width in pixels of the shadow's soft edge.
      Default 12 approximates common CSS box-shadow softness.
      Larger values create softer, more diffuse shadows.  The shadow
      is computed while scanning out, so the radius does not change
      its cost per pixel.

endmenu

menu "Rendering"

config CACHE_SIZE
    int "Coverage cache budget (KiB)"
    default 24
    range 0 4096
    help
      Byte budget for cached anti-aliased coverage masks of glyphs and
      small filled paths.  Repainting a screen of text and rounded
      shapes then composites cached masks instead of re-rasterizing.
      0 disables the cache.

config CACHE_MAX_ENTRY
    int "Largest cached mask (bytes)"
    default 4096
    range 256 65536
    depends on CACHE_SIZE != 0
    help
      Masks larger than this are rasterized every time, clipped to the
      visible region, so one big fill cannot flush the working set.

config WIDGETS
    bool "Box layout widget toolkit"
    default y
    help
      Boxes, labels, buttons and toplevel windows with automatic layout,
      used by the desktop demos.  Applications that draw their own UI
      (such as the cellphone demo) do not need it.

config FONT_MONTSERRAT
    bool "Montserrat Medium font"
    default y
    help
      TrueType outlines of Montserrat Medium (SIL OFL 1.1), ASCII plus a
      few typographic marks.  About 7 KB of read-only data.

config FONT_ICONS
    bool "UI symbol font"
    default y
    help
      Fifty-one Font Awesome 5 Free Solid symbols (CC BY 4.0) for status
      bars, navigation and app icons, as TWIN_SYM_* UTF-8 strings.

endmenu

endmenu

menu "Image Loaders"

config LOADER_PNG
    bool "Enable PNG loader"
    depends on HAVE_LIBPNG
    default y
    help
      Enable PNG (Portable Network Graphics) image loading.
      Supports true color images with alpha transparency.

config LOADER_JPEG
    bool "Enable JPEG loader"
    depends on HAVE_LIBJPEG
    default y
    help
      Enable JPEG/JPG image loading support.
      Supports compressed photographic images.

config LOADER_GIF
    bool "Enable GIF loader"
    default y
    help
      Enable GIF (Graphics Interchange Format) loading.
      Supports animated GIF images and transparency.

config LOADER_TVG
    bool "Enable TinyVG (TVG) loader"
    default y
    help
      Enable TinyVG vector graphics format support.
      Compact binary format for scalable graphics.

config TVG_MEMORY_BUDGET
    int "TVG rendering memory budget (KB)"
    default 0
    range 0 32768
    depends on LOADER_TVG
    help
      Maximum memory in kilobytes for a single TVG pixmap.
      The renderer auto-scales the output to fit within this
      budget while preserving aspect ratio.
      Set to 0 for unlimited (use native document dimensions).

endmenu

menu "Demo Applications"

config DEMO_APPLICATIONS
    bool "Build demo applications"
    default y
    help
      Build demonstration applications showcasing Mado features.
      Provides example code and testing targets.

config DEMO_CELLPHONE
    bool "Build cellphone demo"
    default y
    depends on DEMO_APPLICATIONS && FONT_MONTSERRAT && FONT_ICONS
    depends on WM_MOBILE
    help
      Phone user interface: lock screen, home screen, dialer, contacts,
      messages, calculator, music, photos, camera, settings, call log and
      games, drawn with vector graphics on the mobile window manager.
      Every other app in apps/apps.c marked for the mobile policy (the
      demos selected below) gets a launcher icon too and runs as a
      stacked app; Back closes its windows one at a time.

config DEMO_CELLPHONE_RGB16
    bool "Use RGB565 surfaces for phone screens"
    default n
    depends on DEMO_CELLPHONE
    help
      Halve the memory of every phone screen by rendering into 16-bit
      surfaces.  RGB565 has no alpha channel, so screens are always
      opaque, at the cost of some banding in gradients.

choice
    prompt "Demo scene at startup"
    depends on DEMO_APPLICATIONS
    default DEMO_SCENE_MOBILE if WM_MOBILE
    default DEMO_SCENE_DESKTOP
    help
      The window manager the demo launcher starts under.  Each app in
      apps/apps.c is marked with the window managers it runs under; the
      launcher starts those marked for the scene, or the shell that owns
      it (the phone under the mobile policy).  'No window manager' shows
      the first app full screen.  MADO_SCENE=mobile|desktop|none overrides
      the choice at run time.

config DEMO_SCENE_MOBILE
    bool "Mobile"
    depends on WM_MOBILE

config DEMO_SCENE_DESKTOP
    bool "Desktop"
    depends on WM_DESKTOP

config DEMO_SCENE_NONE
    bool "No window manager"

endchoice

config DEMO_MULTI
    bool "Build multi demo"
    default y
    depends on DEMO_APPLICATIONS && WIDGETS
    help
      Comprehensive demo with multiple windows and widgets.
      Demonstrates window management and event handling: the desktop
      policy staggers its windows, the mobile one stacks them and Back
      closes one at a time.

config DEMO_CLOCK
    bool "Build clock demo"
    default y
    depends on DEMO_APPLICATIONS && WIDGETS
    help
      Analog clock demonstration with real-time updates.
      Showcases CORDIC trigonometry functions.
      Demonstrates timeout callbacks and redraw logic.

config DEMO_CALCULATOR
    bool "Build calculator demo"
    default y
    depends on DEMO_APPLICATIONS && WIDGETS
    help
      Interactive calculator application.
      Demonstrates button widgets and event handling.
      Shows layout management and user input processing.

config DEMO_SPLINE
    bool "Build spline demo"
    default y
    depends on DEMO_APPLICATIONS && WIDGETS
    help
      Bezier spline curve demonstration.
      Shows advanced path rendering capabilities.
      Demonstrates curve smoothing algorithms.

config DEMO_ANIMATION
    bool "Build animation demo"
    default y
    depends on DEMO_APPLICATIONS && WIDGETS
    help
      Animation demonstration with moving objects.
      Shows frame-based animation techniques.
      Demonstrates work queue and timeout systems.

config DEMO_IMAGE
    bool "Build scalable image demo"
    select LOADER_TVG
    default y
    depends on DEMO_APPLICATIONS && WIDGETS
    help
      Scalable vector graphics demonstration.
      Shows TinyVG format rendering capabilities.
      Automatically enables TVG loader.
      Demonstrates resolution-independent graphics.

endmenu

menu "Tools"

config TOOLS
    bool "Build tools"
    default y
    help
      Build development and utility tools.
      Provides additional programs for testing and development.
      Individual tools can be selected below.

config TOOL_FONTEDIT
    bool "Build scalable font editor"
    default y
    depends on TOOLS && HAVE_SDL2 && HAVE_CAIRO && !CROSS_COMPILE_ENABLED && !CC_IS_EMCC
    help
      Interactive font editor for Mado font format.
      Allows creation and modification of scalable fonts.

      Note: Only available for native builds.

config PERF_TEST
    bool "Build performance tester"
    default y
    depends on TOOLS
    help
      Performance benchmarking utility.
      Measures rendering and system performance metrics.
      Useful for validating optimizations and comparing backends.

config TOOL_HEADLESS_CTL
    bool "Build headless backend control tool"
    default y
    depends on TOOLS && BACKEND_HEADLESS
    help
      Control utility for headless backend operations.
      Enables programmatic interaction with headless instances.
      Communicates via shared memory protocol.

endmenu
```
