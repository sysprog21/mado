## configs/defconfig
```kconfig
CONFIG_BACKEND_SDL=y
CONFIG_LOADER_PNG=y
CONFIG_LOADER_JPEG=y
CONFIG_LOADER_GIF=y
CONFIG_APP_MULTI=y
CONFIG_APP_CLOCK=y
CONFIG_APP_CALCULATOR=y
CONFIG_APP_SPLINE=y
CONFIG_APP_ANIMATION=y
CONFIG_MEMORY_STATS=y
```
